// SPDX-License-Identifier: GPL-2.0
/*
 * Copyright (c) 2025, Daniel Maslowski
*/

/dts-v1/;

#include "k230.dtsi"

/ {
	model = "Banana Pi CanMV-K230D-Zero";
	compatible = "canaan,kendryte-k230";

	aliases {
		serial0 = &uart0;
		serial1 = &uart1;
	};

	chosen {
		bootargs = "earlycon=sbi console=tty0 console=ttyS0,115200 loglevel=7";
		stdout-path = "serial0:115200";
	};
};

&uart0 {
	status = "okay";
};
/*
&uart1 {
	status = "okay";
};
*/
